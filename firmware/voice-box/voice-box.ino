// voice-box.ino: paygent voice box firmware (ESP32-S3 N16R8 + INMP441 + MAX98357A + ILI9341).
// Hold the button, speak ("cobrame 40 pesos de unos tacos"), release: the WAV goes to
// POST /api/terminals/:id/voice, the screen shows the amount with the pay QR, and polling the sale shows PAGADO.
// The speaker says the result with recorded clips (clips.h): "pagado, cuarenta pesos" or the error,
// in Spanish or English (BOX_LANG in secrets.h; `lang en` / `lang es` on the serial monitor).

#include <WiFi.h>
#include <HTTPClient.h>
#include <ArduinoJson.h>
#include <ESP_I2S.h>
#include <SPI.h>
#include <Adafruit_GFX.h>
#include <Adafruit_ILI9341.h>
#include <qrcode.h>  // Espressif esp_qrcode, shipped with the ESP32 core (no extra library)
#include "secrets.h"  // WIFI_SSID, WIFI_PASS, SERVER_URL, TERMINAL_ID (copy secrets.example.h)
#include "clips.h"    // recorded speech, generated by `npm run voice:clips`

#ifndef BOX_LANG
#define BOX_LANG "es"  // a secrets.h from before BOX_LANG existed: Spanish
#endif

// Pins (docs/voice-box-hardware.md §3).
constexpr int8_t MIC_SD = 4, MIC_SCK = 5, MIC_WS = 6;
constexpr uint8_t BUTTON = 7;
constexpr int8_t AMP_BCLK = 15, AMP_LRC = 16, AMP_DIN = 17;
constexpr int8_t TFT_SCK = 12, TFT_MOSI = 11, TFT_MISO = 13, TFT_CS = 10, TFT_DC = 9, TFT_RST = 21;

constexpr uint32_t RATE = 16000;
constexpr uint32_t MAX_SECONDS = 6;
constexpr size_t MAX_SAMPLES = RATE * MAX_SECONDS;
constexpr int MIC_SHIFT = 11;  // 24-bit sample in 32 bits -> int16 with ~8x gain (mic-check showed low levels).
constexpr uint32_t PAY_TIMEOUT_MS = 5 * 60 * 1000;
constexpr int VOICE_GAIN_PCT = 100;  // clips are compressed and peak at 95 % of full scale: no clipping
constexpr int WORD_GAP_MS = 60;
static_assert(CLIP_RATE == RATE, "clips.h must match the amplifier's sample rate");
// The panel is natively 320x240 (ILI9342-like) and sits portrait in the box. Logical size comes from
// rotation 0 (240x320); MADCTL 0xE8 (MY|MX|MV|BGR) is the scan that fills it upright (rotation-check).
constexpr uint8_t TFT_MADCTL = 0xE8;

// #RRGGBB -> the panel's 16-bit color. MADCTL's BGR bit swaps red and blue on this panel, so blue
// goes in the high bits (a plain RGB565 red showed up blue on the box). A macro, not a function:
// Arduino puts function prototypes above the first function, before `enum Face` exists.
#define color(hex) \
  ((uint16_t)(((((hex) >> 3) & 0x1F) << 11) | ((((hex) >> 10) & 0x3F) << 5) | (((hex) >> 19) & 0x1F)))

// Palette. Outcomes are high contrast for a stall in sun or shade: GREEN paid and RED failed carry
// white text (≥ 5:1), YELLOW warning carries dark text (≈ 12:1).
constexpr uint16_t BG = color(0xFFF8F8), INK = color(0x202020), CHEEK = color(0xFF6AB0), WHITE = 0xFFFF;
constexpr uint16_t GREEN = color(0x15803D), YELLOW = color(0xFACC15), RED = color(0xB91C1C);

Adafruit_ILI9341 tft(&SPI, TFT_DC, TFT_CS, TFT_RST);
GFXcanvas16 *canvas = nullptr;  // 320x240 frame drawn off-screen, then sent by present().
I2SClass mic, amp;
uint8_t *wav = nullptr;  // 44-byte header + PCM16, in PSRAM.

// The three outcomes tell apart at a glance: PAID green and happy; CONFUSED yellow with "!" (say it
// again, or the charge did not happen); FAILED red with "X" and worried (something broke).
enum Face { IDLE, LISTEN, THINK, OPEN, PAID, CONFUSED, FAILED, OFFLINE };
enum Lang { ES, EN };
Lang lang = strcmp(BOX_LANG, "en") == 0 ? EN : ES;  // what the box asks /voice for and speaks

/** Screen text in the box's language (the built-in font has no accents). */
const char *tr(const char *es, const char *en) { return lang == EN ? en : es; }

// ---------- screen ----------

/** Sends the off-screen frame to the panel in one go, so a face change never flickers. */
void present() {
  const int W = canvas->width(), H = canvas->height();
  tft.startWrite();
  tft.setAddrWindow(0, 0, W, H);
  tft.writePixels(canvas->getBuffer(), W * H);
  tft.endWrite();
}

/** Round badge above the eyes with one big character: "!" for a warning, "X" for a failure. */
void badge(const char *mark, uint16_t disc, uint16_t ink) {
  GFXcanvas16 &g = *canvas;
  const int cx = g.width() / 2, cy = 40;
  int16_t bx, by;
  uint16_t bw, bh;
  g.fillCircle(cx, cy, 22, disc);
  g.setTextSize(4);
  g.setTextColor(ink);
  g.getTextBounds(mark, 0, 0, &bx, &by, &bw, &bh);
  g.setCursor(cx - bw / 2 - bx, cy - bh / 2 - by);
  g.print(mark);
}

void eyes(Face f, uint16_t bg) {
  GFXcanvas16 &g = *canvas;
  const int cx = g.width() / 2, y = 110, lx = cx - 45, rx = cx + 45;
  for (int x : {lx, rx}) {
    switch (f) {
      case IDLE:
      case OFFLINE:  // closed: thick line
        g.fillRoundRect(x - 20, y - 3, 40, 7, 3, INK);
        break;
      case PAID:  // happy ^ ^
        for (int t = 0; t < 6; t++) {
          g.drawLine(x - 20, y + 8 + t / 2, x, y - 10 + t / 2, INK);
          g.drawLine(x, y - 10 + t / 2, x + 20, y + 8 + t / 2, INK);
        }
        break;
      case CONFUSED:
        g.fillCircle(x, y, 16, INK);
        g.fillCircle(x + 5, y - 6, 5, WHITE);
        g.fillRect(x - 22, y - 34, 44, 6, INK);  // brows
        break;
      case FAILED: {  // wide eyes, brows raised toward the middle (worried)
        g.fillCircle(x, y, 20, INK);
        g.fillCircle(x + 6, y - 7, 6, WHITE);
        int in = x < cx ? 1 : -1;  // which way the brow's inner end is
        for (int t = 0; t < 6; t++) g.drawLine(x - 24 * in, y - 30 + t, x + 18 * in, y - 42 + t, INK);
        break;
      }
      default: {  // open eyes; THINK looks up, LISTEN is bigger
        int r = f == LISTEN ? 22 : 18, dy = f == THINK ? -8 : 0;
        g.fillCircle(x, y, r, INK);
        g.fillCircle(x + 6, y - 7 + dy, r / 3, WHITE);
      }
    }
  }
  if (f != OFFLINE && f != FAILED) {
    g.fillCircle(cx - 80, 145, 12, CHEEK);
    g.fillCircle(cx + 80, 145, 12, CHEEK);
  }
  if (f == CONFUSED) badge("!", INK, YELLOW);
  if (f == FAILED) badge("X", WHITE, RED);
  // Mouth: arc for smile, frown when failed, flat when confused, small "o" when listening.
  if (f == LISTEN) {
    g.fillCircle(cx, 160, 10, INK);
    g.fillCircle(cx, 160, 5, bg);
  } else if (f == CONFUSED) {
    g.fillRect(cx - 20, 160, 40, 5, INK);
  } else if (f == FAILED) {
    for (int t = 0; t < 4; t++) g.drawCircleHelper(cx, 182 + t, 24, 0x1 | 0x2, INK);
  } else {
    for (int t = 0; t < 4; t++) g.drawCircleHelper(cx, 140 + t, 24, 0x4 | 0x8, INK);
  }
}

void face(Face f, const String &line1 = "", const String &line2 = "") {
  GFXcanvas16 &g = *canvas;
  uint16_t bg = f == PAID ? GREEN : f == CONFUSED ? YELLOW : f == FAILED ? RED : f == OFFLINE ? 0xC618 : BG;
  g.fillScreen(bg);
  eyes(f, bg);
  g.setTextColor(f == PAID || f == FAILED ? WHITE : INK);
  g.setTextWrap(false);
  int16_t x, y;
  uint16_t w, h;
  if (line1.length()) {
    g.setTextSize(line1.length() > 10 ? 3 : 4);
    g.getTextBounds(line1, 0, 0, &x, &y, &w, &h);
    g.setCursor(max(0, (g.width() - (int)w) / 2), 210);
    g.print(line1);
  }
  if (line2.length()) {
    g.setTextSize(2);
    g.getTextBounds(line2, 0, 0, &x, &y, &w, &h);
    g.setCursor(max(0, (g.width() - (int)w) / 2), 265);
    g.print(line2);
  }
  present();
}

// Where esp_qrcode's callback draws: it only gets the encoded code, so the area goes through globals.
constexpr int QR_TOP = 50, QR_ROOM = 240;  // full width, 240 px tall below the amount
int qrScale = 0;

/** esp_qrcode display callback: black modules on the white canvas, with a 4-module quiet zone. */
void drawQr(esp_qrcode_handle_t q) {
  GFXcanvas16 &g = *canvas;
  const int n = esp_qrcode_get_size(q);
  qrScale = max(1, QR_ROOM / (n + 8));
  const int side = n * qrScale, ox = (g.width() - side) / 2, oy = QR_TOP + (QR_ROOM - side) / 2;
  for (int r = 0; r < n; r++)
    for (int c = 0; c < n; c++)
      if (esp_qrcode_get_module(q, c, r)) g.fillRect(ox + c * qrScale, oy + r * qrScale, qrScale, qrScale, 0x0000);
}

/** Charge screen: amount on top, the sale's pay URL as a big QR on white, "scan to pay" below. */
void payScreen(const String &amount, const String &url) {
  GFXcanvas16 &g = *canvas;
  g.fillScreen(WHITE);
  g.setTextWrap(false);
  g.setTextColor(0x0000);
  int16_t x, y;
  uint16_t w, h;
  g.setTextSize(amount.length() > 10 ? 3 : 4);
  g.getTextBounds(amount, 0, 0, &x, &y, &w, &h);
  g.setCursor(max(0, (g.width() - (int)w) / 2), 10);
  g.print(amount);
  esp_qrcode_config_t cfg = {drawQr, 10, ESP_QRCODE_ECC_MED};
  qrScale = 0;
  if (esp_qrcode_generate(&cfg, url.c_str()) == ESP_OK && qrScale)
    Serial.printf("pay QR %d px/module: %s\n", qrScale, url.c_str());
  else
    Serial.printf("pay QR failed: %s\n", url.c_str());
  const char *hint = tr("Escanea para pagar", "Scan to pay");
  g.setTextSize(2);
  g.getTextBounds(hint, 0, 0, &x, &y, &w, &h);
  g.setCursor(max(0, (g.width() - (int)w) / 2), 296);
  g.print(hint);
  present();
}

// ---------- sound ----------

void tone(int hz, int ms, int vol = 15000) {  // default: as loud as the voice (the chime before "pagado")
  static int16_t buf[RATE / 50];
  uint32_t n = 0;
  for (int c = 0; c < ms / 20; c++) {
    for (size_t i = 0; i < sizeof(buf) / 2; i++, n++) buf[i] = (int16_t)(vol * sin(2 * PI * hz * n / RATE));
    amp.write((uint8_t *)buf, sizeof(buf));
  }
}

void chimePaid() {
  tone(660, 120);
  tone(880, 120);
  tone(1320, 240);
}

// ---------- voice ----------

int16_t mulawDecode(uint8_t u) {
  u = ~u;
  int t = (((u & 0x0F) << 3) + 0x84) << ((u & 0x70) >> 4);
  return (u & 0x80) ? (0x84 - t) : (t - 0x84);
}

void silence(int ms) {
  static int16_t zero[RATE / 100] = {0};  // 10 ms
  for (int i = 0; i < ms / 10; i++) amp.write((uint8_t *)zero, sizeof(zero));
}

const Clip *findClip(const char *key) {
  const Clip *table = lang == EN ? CLIPS_EN : CLIPS_ES;
  size_t count = lang == EN ? CLIP_COUNT_EN : CLIP_COUNT_ES;
  for (size_t i = 0; i < count; i++)
    if (strcmp(table[i].key, key) == 0) return &table[i];
  return nullptr;
}

void playClip(const Clip &c) {
  static int16_t buf[256];
  for (uint32_t i = 0; i < c.len;) {
    size_t n = 0;
    for (; n < 256 && i < c.len; n++, i++) buf[n] = mulawDecode(c.data[i]) * VOICE_GAIN_PCT / 100;
    amp.write((uint8_t *)buf, n * 2);
  }
}

/** Says space-separated clip keys in order ("paid cuarenta pesos"); a key without a clip is skipped. */
void say(const String &keys) {
  int from = 0;
  while (from < (int)keys.length()) {
    int to = keys.indexOf(' ', from);
    if (to < 0) to = keys.length();
    String key = keys.substring(from, to);
    from = to + 1;
    if (!key.length()) continue;
    const Clip *c = findClip(key.c_str());
    if (!c) {
      Serial.printf("say: no clip for '%s'\n", key.c_str());
      continue;
    }
    playClip(*c);
    silence(WORD_GAP_MS);
  }
  silence(100);  // flush the DMA so the last word is not cut
}

/** What the box shows and says for each outcome; titles fit the screen (at most 13 characters). */
struct Message {
  const char *clip, *es, *en;
  Face face;
};
const Message MESSAGES[] = {
    {"paid", "PAGADO", "PAID", PAID},
    // Failed, red: something broke and the charge could not go through.
    {"err_wifi", "Sin internet", "No internet", FAILED},
    {"err_server", "Sin servidor", "No server", FAILED},
    {"err_internal", "Error", "Error", FAILED},
    {"err_stt_off", "Voz apagada", "STT off", FAILED},
    {"err_stt_failed", "Audio fallo", "Audio failed", FAILED},
    {"err_paypal", "PayPal fallo", "PayPal failed", FAILED},
    {"err_terminal", "Sin registro", "Unregistered", FAILED},
    {"sale_failed", "Pago fallo", "Pay failed", FAILED},
    // Warning, yellow: nothing broke; say it again or start a new charge.
    {"err_amount", "Sin monto", "No amount", CONFUSED},
    {"err_unknown", "Repitelo", "Say again", CONFUSED},
    {"sale_cancelled", "Cancelado", "Cancelled", CONFUSED},
    {"sale_expired", "Vencido", "Expired", CONFUSED},
};

/**
 * Shows the face and title of `clip` with `detail` under it, then says `clip` and `words` after it
 * ("paid" + "cuarenta pesos", with the chime first). False when `clip` is not a message.
 */
bool tell(const String &clip, const String &detail = "", const String &words = "") {
  for (const auto &m : MESSAGES) {
    if (clip != m.clip) continue;
    face(m.face, tr(m.es, m.en), detail);
    if (m.face == PAID) chimePaid();
    say(words.length() ? clip + " " + words : clip);
    return true;
  }
  return false;
}

/** Shows and says what went wrong with a /voice request (`error` is the server's code, if any). */
void sayError(const String &error, int code) {
  struct {
    const char *error, *clip;
  } const known[] = {
      {"TRANSCRIBE_UNAVAILABLE", "err_stt_off"}, {"TRANSCRIBE_FAILED", "err_stt_failed"},
      {"PAYPAL_ERROR", "err_paypal"},            {"TERMINAL_NOT_FOUND", "err_terminal"},
      {"EMPTY_SALE", "err_amount"},
  };
  const char *clip = "err_internal";
  for (const auto &k : known)
    if (error == k.error) clip = k.clip;
  tell(clip, error.length() ? error.substring(0, 20) : String(code));
}

// ---------- recording ----------

void putLE(uint8_t *p, uint32_t v, int n) {
  for (int i = 0; i < n; i++) p[i] = (v >> (8 * i)) & 0xFF;
}

void wavHeader(uint32_t samples) {
  uint32_t data = samples * 2;
  memcpy(wav, "RIFF", 4);
  putLE(wav + 4, 36 + data, 4);
  memcpy(wav + 8, "WAVEfmt ", 8);
  putLE(wav + 16, 16, 4);
  putLE(wav + 20, 1, 2);  // PCM
  putLE(wav + 22, 1, 2);  // mono
  putLE(wav + 24, RATE, 4);
  putLE(wav + 28, RATE * 2, 4);
  putLE(wav + 32, 2, 2);
  putLE(wav + 34, 16, 2);
  memcpy(wav + 36, "data", 4);
  putLE(wav + 40, data, 4);
}

/** Records while the button is held (max MAX_SECONDS); returns the sample count. */
uint32_t record() {
  int16_t *pcm = (int16_t *)(wav + 44);
  static int32_t raw[256];
  uint32_t n = 0;
  while (digitalRead(BUTTON) == LOW && n < MAX_SAMPLES) {
    size_t got = mic.readBytes((char *)raw, sizeof(raw)) / 4;
    for (size_t i = 0; i < got && n < MAX_SAMPLES; i++) {
      int32_t s = raw[i] >> MIC_SHIFT;
      pcm[n++] = (int16_t)constrain(s, -32768, 32767);
    }
  }
  return n;
}

// ---------- network ----------

bool wifiUp() {
  if (WiFi.status() == WL_CONNECTED) return true;
  face(OFFLINE, tr("Sin internet", "No internet"), tr("conectando...", "connecting..."));
  WiFi.begin(WIFI_SSID, WIFI_PASS);
  for (int i = 0; i < 40 && WiFi.status() != WL_CONNECTED; i++) delay(250);
  if (WiFi.status() != WL_CONNECTED) return false;
  Serial.printf("wifi ok, ip %s\n", WiFi.localIP().toString().c_str());
  return true;
}

String money(long minor, const char *cur) {
  String s = String(minor / 100);
  if (minor % 100) s += "." + String(minor % 100 + 100).substring(1);
  return s + " " + cur;
}

/** Polls the sale until paid, cancelled/expired/failed, a new press, or the timeout. */
void waitForPayment(const String &saleId, const String &amount, const String &spoken) {
  uint32_t start = millis();
  HTTPClient http;
  while (millis() - start < PAY_TIMEOUT_MS) {
    for (int i = 0; i < 30; i++) {  // 1.5 s, but a press interrupts
      if (digitalRead(BUTTON) == LOW) return;
      delay(50);
    }
    http.begin(String(SERVER_URL) + "/api/sales/" + saleId);
    int code = http.GET();
    if (code == 200) {
      JsonDocument doc;
      if (!deserializeJson(doc, http.getString())) {
        String status = doc["sale"]["status"] | "";
        if (status == "paid") {
          http.end();
          tell("paid", amount, spoken);
          delay(4000);
          return;
        }
        if (status == "cancelled" || status == "expired" || status == "failed") {
          http.end();
          tell("sale_" + status);
          delay(1500);
          return;
        }
      }
    }
    http.end();
  }
}

void handlePress() {
  face(LISTEN, tr("Te escucho...", "Listening..."));
  tone(880, 60, 3000);
  uint32_t n = record();
  Serial.printf("recorded %lu samples (%.1f s)\n", (unsigned long)n, n / (float)RATE);
  if (n < RATE / 3) {  // under ~0.3 s: a tap, not speech
    face(IDLE);
    return;
  }
  face(THINK, "...");
  if (!wifiUp()) {
    tell("err_wifi");
    return;
  }
  wavHeader(n);
  HTTPClient http;
  http.setTimeout(30000);
  http.begin(String(SERVER_URL) + "/api/terminals/" + TERMINAL_ID + "/voice?lang=" + (lang == EN ? "en" : "es"));
  http.addHeader("Content-Type", "audio/wav");
  int code = http.POST(wav, 44 + n * 2);
  String body = code > 0 ? http.getString() : "";
  http.end();
  Serial.printf("POST voice -> %d %s\n", code, body.substring(0, 200).c_str());

  if (code <= 0) {  // no HTTP answer at all: server down, wrong SERVER_URL, or timeout
    tell("err_server", String(code));
    delay(1500);
    face(IDLE);
    return;
  }
  JsonDocument doc;
  bool json = !deserializeJson(doc, body);
  if (code >= 400 || !json) {
    sayError(json ? String(doc["error"] | "") : "", code);
    delay(1500);
    face(IDLE);
    return;
  }
  String intent = doc["intent"] | "";
  if (intent != "charge") {
    String heard = doc["text"] | "";
    tell("err_unknown", heard.substring(0, 18));
    delay(1500);
    face(IDLE);
    return;
  }
  long minor = doc["sale"]["total"]["minor"] | 0L;
  String amount = money(minor, doc["sale"]["total"]["currency"] | "");
  String saleId = doc["sale"]["id"] | "";
  payScreen(amount, String(SERVER_URL) + "/pay/" + saleId);  // same page /t/:terminal redirects to
  tone(660, 100);
  waitForPayment(saleId, amount, doc["spoken"] | "");
  if (digitalRead(BUTTON) != LOW) face(IDLE);
}

// ---------- main ----------

void setup() {
  Serial.begin(115200);
  delay(300);
  Serial.println("\n== Paygenti voice box ==");
  pinMode(BUTTON, INPUT_PULLUP);

  SPI.begin(TFT_SCK, TFT_MISO, TFT_MOSI, TFT_CS);
  tft.begin(40000000);
  tft.setRotation(0);  // 240x320 logical size
  const uint8_t madctl = TFT_MADCTL;
  tft.sendCommand(ILI9341_MADCTL, &madctl, 1);
  canvas = new GFXcanvas16(tft.width(), tft.height());
  if (!canvas->getBuffer()) Serial.println("canvas alloc FAIL");

  wav = (uint8_t *)ps_malloc(44 + MAX_SAMPLES * 2);
  if (!wav) Serial.println("PSRAM alloc FAIL");

  mic.setPins(MIC_SCK, MIC_WS, -1, MIC_SD);
  bool micOk = mic.begin(I2S_MODE_STD, RATE, I2S_DATA_BIT_WIDTH_32BIT, I2S_SLOT_MODE_MONO, I2S_STD_SLOT_LEFT);
  amp.setPins(AMP_BCLK, AMP_LRC, AMP_DIN);
  bool ampOk = amp.begin(I2S_MODE_STD, RATE, I2S_DATA_BIT_WIDTH_16BIT, I2S_SLOT_MODE_MONO);
  Serial.printf("mic %s, amp %s\n", micOk ? "OK" : "FAIL", ampOk ? "OK" : "FAIL");

  wifiUp();
  face(IDLE);
  Serial.printf("server %s, terminal %s, lang %s, clips es %u / en %u; hold the button to talk\n",
                SERVER_URL, TERMINAL_ID, lang == EN ? "en" : "es", (unsigned)CLIP_COUNT_ES,
                (unsigned)CLIP_COUNT_EN);
}

void loop() {
  if (digitalRead(BUTTON) == LOW && wav) {
    delay(20);
    if (digitalRead(BUTTON) == LOW) handlePress();
  }
  // Test hook: "lang en" / "lang es" switches the language; any other line is clip keys to say. A line
  // that starts with a message ("paid cuarenta pesos", "err_amount") also shows its face, as the real
  // flow does, with the rest of the words under the title.
  if (Serial.available()) {
    String line = Serial.readStringUntil('\n');
    line.trim();
    if (line == "lang en" || line == "lang es") {
      lang = line == "lang en" ? EN : ES;
      Serial.printf("lang: %s\n", lang == EN ? "en" : "es");
      face(IDLE);
    } else if (line == "net") {  // reachability check without talking: GET /api/health on SERVER_URL
      if (!wifiUp()) {
        Serial.println("net: no wifi");
        tell("err_wifi");
      } else {
        HTTPClient http;
        http.setTimeout(5000);
        http.begin(String(SERVER_URL) + "/api/health");
        int code = http.GET();
        String body = code > 0 ? http.getString() : "";
        http.end();
        Serial.printf("net: GET %s/api/health -> %d %s\n", SERVER_URL, code, body.substring(0, 160).c_str());
        if (code != 200) tell("err_server", String(code));
      }
      delay(1500);
      face(IDLE);
    } else if (line.length()) {
      Serial.printf("say: %s\n", line.c_str());
      int sp = line.indexOf(' ');
      String first = sp < 0 ? line : line.substring(0, sp), rest = sp < 0 ? "" : line.substring(sp + 1);
      bool shown = tell(first, rest.substring(0, 20), rest);
      if (!shown) say(line);
      Serial.println("say: done");
      if (shown) {
        delay(1500);
        face(IDLE);
      }
    }
  }
  delay(10);
}
